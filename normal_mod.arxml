AUTOSAR XML
4 x :
  ContainerA  # BB
  ContainerB  # AA
  ContainerC  # CC
  ContainerF  # BB
