AUTOSAR XML
4 x :
  ContainerB  # AA
  ContainerA  # BB
  ContainerF  # BB
  ContainerC  # CC
